## boards/shields/skeletyl/Kconfig.shield
```kconfig
# Copyright (c) 2020 Pete Johanson
# SPDX-License-Identifier: MIT

config SHIELD_SKELETYL_LEFT
	def_bool $(shields_list_contains,skeletyl_left)

config SHIELD_SKELETYL_RIGHT
	def_bool $(shields_list_contains,skeletyl_right)
```

## config/boards/shields/chocv/Kconfig.defconfig
```kconfig
if SHIELD_CHOCV

config ZMK_KEYBOARD_NAME
    default "hieutt-chocv"

config ZMK_MOUSE
    default y

endif
```

## config/west.yml
```yaml
manifest:
  remotes:
    - name: zmkfirmware
      url-base: https://github.com/zmkfirmware
    - name: krikun98
      url-base: https://github.com/krikun98
    - name: ftc
      url-base: https://github.com/ftc
    - name: urob
      url-base: https://github.com/urob
  projects:
    - name: zmk
      remote: urob
      revision: main
      import: app/west.yml
  self:
    path: config
```
